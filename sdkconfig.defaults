## sdkconfig.defaults
```kconfig
# Enable IP forwarding and NAT (NAPT)
CONFIG_LWIP_IP_FORWARD=y
CONFIG_LWIP_NAT=y
CONFIG_LWIP_IPV4_NAPT=y

# Allow forwarding between STA and AP interfaces
CONFIG_IP_FORWARD_ALLOW_TX_ON_RX_NETIF=y

# Optimize for ESP32-C3
CONFIG_ESPTOOLPY_FLASHSIZE_4MB=y
CONFIG_ESPTOOLPY_FLASHMODE_QIO=y

# Optimize for 4MB flash ESP32-C3
CONFIG_PARTITION_TABLE_CUSTOM=y
CONFIG_PARTITION_TABLE_FILENAME="partitions_4MB.csv"

# ESP-NOW Configuration
CONFIG_ESP_NOW_ENABLED=y
```
